## sdkconfig.defaults
```kconfig
# PSRAM: 本板实测无法启用（quad_psram 报错），关闭
# CONFIG_SPIRAM is not set

# Target
CONFIG_IDF_TARGET="esp32s3"
CONFIG_IDF_TARGET_ESP32S3=y

# SPI Flash
CONFIG_ESPTOOLPY_FLASHSIZE_4MB=y

# Partition Table
CONFIG_PARTITION_TABLE_CUSTOM=y
CONFIG_PARTITION_TABLE_CUSTOM_FILENAME="partitions.csv"

# WiFi (reduce buffers to save ~40KB for BLE)
CONFIG_ESP_WIFI_ENABLED=y
CONFIG_ESP_WIFI_STATIC_RX_BUFFER_NUM=4
CONFIG_ESP_WIFI_DYNAMIC_RX_BUFFER_NUM=16
CONFIG_ESP_WIFI_DYNAMIC_TX_BUFFER_NUM=16
CONFIG_ESP_WIFI_MGMT_SBUF=8

# LVGL 字体
CONFIG_LV_FONT_MONTSERRAT_10=y
CONFIG_LV_FONT_MONTSERRAT_12=y
CONFIG_LV_FONT_MONTSERRAT_14=y
CONFIG_LV_FONT_MONTSERRAT_18=y
CONFIG_LV_FONT_MONTSERRAT_32=y
CONFIG_LV_FONT_DEFAULT_MONTSERRAT_14=y

# FreeRTOS
CONFIG_FREERTOS_HZ=1000

# ESP HTTP Client
CONFIG_ESP_HTTP_CLIENT_ENABLE_HTTPS=n

# BT (from cuktech repo)
CONFIG_BT_ENABLED=y
CONFIG_BT_NIMBLE_ENABLED=y
CONFIG_BT_BLUEDROID_ENABLED=n
CONFIG_BT_NIMBLE_ROLE_CENTRAL=y
CONFIG_BT_NIMBLE_ROLE_PERIPHERAL=n
CONFIG_BT_NIMBLE_ROLE_BROADCASTER=n
CONFIG_BT_NIMBLE_ROLE_OBSERVER=n
CONFIG_BT_NIMBLE_MAX_CONNECTIONS=1
CONFIG_BTDM_CTRL_MODE_BLE_ONLY=y
CONFIG_BT_NIMBLE_4_1_COMPAT=y
CONFIG_BT_NIMBLE_LOG_LEVEL=4
CONFIG_BT_CTRL_MODEM_SLEEP=y
CONFIG_BT_NIMBLE_HS_FLOW_CTRL=y
CONFIG_BT_NIMBLE_HS_FLOW_CTRL_ITVL=1000
CONFIG_BT_NIMBLE_HS_FLOW_CTRL_THRESH=2
CONFIG_BT_NIMBLE_HS_FLOW_CTRL_TX_ON_DISCONNECT=y

# MQTT
CONFIG_MQTT_PROTOCOL_311=y

# LWIP (more sockets for HTTP + MQTT + OTA)
CONFIG_LWIP_MAX_SOCKETS=16

# HTTP Server (prevent ENFILE fd exhaustion)
CONFIG_HTTPD_MAX_REQ_HDR_LEN=1024
CONFIG_HTTPD_MAX_URI_LEN=1024

# mbedTLS (for crypto)
CONFIG_MBEDTLS_MD_C=y
CONFIG_MBEDTLS_CCM_C=y
CONFIG_MBEDTLS_SHA256_C=y
CONFIG_MBEDTLS_HKDF_C=y

# BLE + WiFi Coexistence
CONFIG_ESP_COEX_SW_COEXIST_ENABLE=y
CONFIG_ESP32_WIFI_SW_COEXIST_ENABLE=y
CONFIG_ESP_SYSTEM_EVENT_TASK_STACK_SIZE=4096


# Reduce BLE buffers to save memory
CONFIG_BT_NIMBLE_MSYS_1_BLOCK_COUNT=4
CONFIG_BT_NIMBLE_MSYS_2_BLOCK_COUNT=8
CONFIG_BT_NIMBLE_TRANSPORT_ACL_FROM_LL_COUNT=8
CONFIG_BT_NIMBLE_HCI_EVT_HI_BUF_COUNT=10
CONFIG_BT_NIMBLE_HCI_EVT_LO_BUF_COUNT=4
```
